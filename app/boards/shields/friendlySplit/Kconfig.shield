## app/boards/shields/friendlySplit/Kconfig.shield
```kconfig
# Copyright (c) 2020 Yodi Vandenhende
# SPDX-License-Identifier: MIT

config SHIELD_FRIENDLYSPLIT_LEFT
    def_bool $(shields_list_contains,friendlySplit_left)

config SHIELD_FRIENDLYSPLIT_RIGHT
    def_bool $(shields_list_contains,friendlySplit_right)
```
